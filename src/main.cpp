#include <WiFi.h>
#include <WiFiManager.h>
#include <HTTPClient.h>
#include <Wire.h>
#include <Adafruit_GFX.h>
#include <Adafruit_SSD1306.h>
#include <OneWire.h>
#include <DallasTemperature.h>
#include <Preferences.h>

// ---------- OLED ----------
#define SCREEN_WIDTH  128
#define SCREEN_HEIGHT 64
#define OLED_RESET    -1
#define OLED_ADDR     0x3C

// ---------- Sensor ----------
#define ONE_WIRE_BUS  4

// ---------- Tombol reset WiFi ----------
#define RESET_BUTTON_PIN 18

// ---------- Konfigurasi ----------
const char* AP_NAME     = "ESP32-IoT-Setup";
const char* AP_PASSWORD = "12345678";  // minimal 8 karakter
const char* apiEndpoint = "http://172.16.10.8:8003/api/monitoring"; // GANTI
const char* unit        = "C";
const unsigned long sendInterval = 5000; // 5000 ms = 5 detik

// ---------- Objek ----------
Adafruit_SSD1306 display(SCREEN_WIDTH, SCREEN_HEIGHT, &Wire, OLED_RESET);
OneWire oneWire(ONE_WIRE_BUS);
DallasTemperature sensors(&oneWire);
Preferences prefs;

String device_id = "esp32-01";

// ================= State =================
unsigned long lastSend = 0;
int  lastHttpCode = 0;     // 0 = belum kirim, >0 = kode HTTP, <0 = error koneksi
bool hasSentOnce  = false;

// ================= IMAGE =================
// 'deer', 128x64px
const unsigned char epd_bitmap_deer [] PROGMEM = {
	0x00, 0x00, 0x00, 0x00, 0x00, 0x00, 0x00, 0x00, 0x00, 0x00, 0x00, 0x00, 0x00, 0x00, 0x00, 0x00, 
	0x00, 0x00, 0x00, 0x00, 0x00, 0x00, 0x00, 0x00, 0x00, 0x00, 0x00, 0x00, 0x00, 0x00, 0x00, 0x00, 
	0x00, 0x00, 0x00, 0x00, 0x00, 0x00, 0x00, 0x06, 0x00, 0x00, 0x00, 0x00, 0x00, 0x00, 0x00, 0x00, 
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	0x00, 0x00, 0x00, 0x00, 0x00, 0x00, 0x00, 0x00, 0x00, 0x00, 0x00, 0x00, 0x00, 0x00, 0x00, 0x00
};

// 'name', 128x64px
const unsigned char epd_bitmap_name [] PROGMEM = {
	0x00, 0x00, 0x00, 0x00, 0x00, 0x00, 0x00, 0x00, 0x00, 0x00, 0x00, 0x00, 0x00, 0x00, 0x00, 0x00, 
	0x00, 0x00, 0x00, 0x00, 0x00, 0x00, 0x00, 0x00, 0x00, 0x00, 0x00, 0x00, 0x00, 0x00, 0x00, 0x00, 
	0x00, 0x00, 0x00, 0x00, 0x00, 0x00, 0x00, 0x00, 0x00, 0x00, 0x00, 0x00, 0x00, 0x00, 0x00, 0x00, 
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	0x00, 0x00, 0x00, 0x00, 0x00, 0x00, 0x00, 0x00, 0x00, 0x00, 0x00, 0x00, 0x00, 0x00, 0x00, 0x00
};

// ANIMATION EFFECT
void wipeIn(const unsigned char *img) {
  for (int h = 0; h <= 64; h += 2) {
    display.clearDisplay();
    display.drawBitmap(0, 0, img, 128, h, SSD1306_WHITE);
    display.display();
    delay(10);
  }
}

void holdImage(const unsigned char *img, int ms) {
  display.clearDisplay();
  display.drawBitmap(0, 0, img, 128, 64, SSD1306_WHITE);
  display.display();
  delay(ms);
}

// ================= OLED Helpers =================
void showBootScreen() {
  display.clearDisplay();
  display.setTextSize(1);
  display.setTextColor(SSD1306_WHITE);
  display.setCursor(0, 0);
  display.println("IoT Temperature");
  display.println("Booting...");
  display.clearDisplay();

  wipeIn(epd_bitmap_name);     
  holdImage(epd_bitmap_name, 1500);    
  display.clearDisplay();

  delay(200);

  // === Gambar 2 ===
  wipeIn(epd_bitmap_deer);   
  holdImage(epd_bitmap_deer, 1500);

  display.display();
}

void showWifiSetupScreen(WiFiManager *wm) {
  display.clearDisplay();
  display.setTextSize(1);
  display.setTextColor(SSD1306_WHITE);
  display.setCursor(0, 0);
  display.println("WiFi Setup Mode");
  display.println("----------------");
  display.print("SSID: ");
  display.println(AP_NAME);
  display.print("Pass: ");
  display.println(AP_PASSWORD);
  display.print("IP  : ");
  display.println(WiFi.softAPIP());
  display.display();
}

void showMainScreen(float tempC, unsigned long uptime) {
  display.clearDisplay();
  display.setTextSize(1);
  display.setTextColor(SSD1306_WHITE);

  // Baris 1: status WiFi (SSID jika terhubung)
  display.setCursor(0, 0);
  // if (WiFi.status() == WL_CONNECTED) {
  //   String ssid = WiFi.SSID();
  //   if (ssid.length() > 14) ssid = ssid.substring(0, 14);
  //   display.print("WiFi: ");
  //   display.println(ssid);
  // } else {
  //   display.println("WiFi: Disconnected");
  // }

  display.println("Device ID: " + device_id);

  // Baris 2-3: temperatur besar
  display.setTextSize(2);
  display.setCursor(0, 16);
  display.print(tempC, 2);
  display.print(" ");
  display.print(unit);

  // Baris 4: uptime (tidak ditampilkan)
  // display.setTextSize(1);
  // display.setCursor(0, 40);
  // display.print("Uptime: ");
  // display.print(uptime);
  // display.println(" s");

  // Baris 5: status API (hanya kode)
  display.setCursor(0, 52);
  display.print("API : ");
  if (!hasSentOnce) {
    display.println("waiting...");
  } else if (lastHttpCode > 0) {
    display.print("HTTP ");
    display.println(lastHttpCode);
  } else {
    display.print("Error ");
    display.println(lastHttpCode);
  }

  display.display();
}

// ================= Serial Command =================
void handleSerialCommand() {
  if (!Serial.available()) return;

  String cmd = Serial.readStringUntil('\n');
  cmd.trim();
  cmd.toUpperCase();

  if (cmd == "RESETWIFI") {
    Serial.println(">> Reset WiFi settings...");
    WiFiManager wm;
    wm.resetSettings();
    delay(500);
    ESP.restart();
  }
  else if (cmd == "REBOOT") {
    Serial.println(">> Reboot...");
    ESP.restart();
  }
  else if (cmd.startsWith("DEVICE_ID=")) {
    String newId = cmd.substring(10);
    newId.trim();
    if (newId.length() > 0) {
      prefs.putString("device_id", newId);
      device_id = newId;
      Serial.print(">> Device ID disimpan: ");
      Serial.println(device_id);
    }
  }
  else if (cmd == "STATUS") {
    Serial.printf(">> device_id=%s  WiFi=%d  HTTP=%d\n",
                  device_id.c_str(), WiFi.status(), lastHttpCode);
  }
  else {
    Serial.println(">> Perintah: RESETWIFI | REBOOT | STATUS | DEVICE_ID=xxx");
  }
}

// ================= Tombol Reset WiFi =================
void checkResetButton() {
  static unsigned long pressStart = 0;

  if (digitalRead(RESET_BUTTON_PIN) == LOW) {
    if (pressStart == 0) pressStart = millis();
    if (millis() - pressStart > 3000) {
      Serial.println(">> Tombol ditekan 3 detik, reset WiFi...");
      display.clearDisplay();
      display.setCursor(0, 0);
      display.println("Reset WiFi...");
      display.display();

      WiFiManager wm;
      wm.resetSettings();
      delay(500);
      ESP.restart();
    }
  } else {
    pressStart = 0;
  }
}

// ================= Kirim ke API =================
int sendData(float temperature, unsigned long uptime) {
  if (WiFi.status() != WL_CONNECTED) {
    Serial.println("WiFi terputus, kirim dibatalkan");
    return -1;
  }

  // Kirim sebagai query parameter (tetap method POST, body kosong)
  String url = String(apiEndpoint)
             + (String(apiEndpoint).indexOf('?') >= 0 ? "&" : "?")
             + "temp=" + String(temperature, 2)
             + "&id_devices=" + String(device_id)
             + "&unit=" + String(unit)
             + "&uptime=" + String(uptime)
             + "&status=Online";

  HTTPClient http;
  http.begin(url);
  http.setTimeout(5000);

  Serial.println("POST url:");
  Serial.println(url);

  int code = http.POST("");

  // Hanya tampilkan kode status, bukan raw body
  if (code > 0) {
    Serial.printf("API status code: %d\n", code);
  } else {
    Serial.printf("API error: %s\n", http.errorToString(code).c_str());
  }

  http.end();
  return code;
}

// ================= Setup =================
void setup() {
  Serial.begin(115200);
  delay(200);

  pinMode(RESET_BUTTON_PIN, INPUT_PULLUP);

  sensors.begin();
  Wire.begin(21, 22);

  if (!display.begin(SSD1306_SWITCHCAPVCC, OLED_ADDR)) {
    Serial.println("OLED gagal diinisialisasi");
    while (true) delay(100);
  }
  showBootScreen();

  // Load device_id dari NVS; kalau belum di-set, turunkan dari MAC unik ESP32
  prefs.begin("iot", false);
  char macBuf[20];
  snprintf(macBuf, sizeof(macBuf), "esp32-%04X%08X",
           (uint16_t)(ESP.getEfuseMac() >> 32), (uint32_t)ESP.getEfuseMac());
  device_id = prefs.getString("device_id", macBuf);
  Serial.print("Device ID: ");
  Serial.println(device_id);

  // ---- WiFiManager (ganti WiFi tanpa upload ulang) ----
  WiFiManager wm;
  wm.setConfigPortalTimeout(180);       // timeout portal 3 menit
  wm.setAPCallback(showWifiSetupScreen);
  // wm.resetSettings();                 // uncomment untuk uji coba

  // ---- WiFi: deteksi Wokwi vs hardware asli ----
  Serial.println("Scanning WiFi...");
  int n = WiFi.scanNetworks();

  bool isWokwi = false;
  for (int i = 0; i < n; i++) {
    if (WiFi.SSID(i) == "Wokwi-GUEST") {
      isWokwi = true;
      break;
    }
  }

  if (isWokwi) {
    // === MODE SIMULASI WOKWI ===
    Serial.println("Wokwi terdeteksi → connect ke Wokwi-GUEST");
    WiFi.begin("Wokwi-GUEST", "", 6);  // channel 6 biar cepat

    unsigned long start = millis();
    while (WiFi.status() != WL_CONNECTED && millis() - start < 10000) {
      delay(200);
      Serial.print(".");
    }
  } else {
    // === MODE HARDWARE ASLI ===
    Serial.println("Hardware asli → pakai WiFiManager");
    WiFiManager wm;
    wm.setConfigPortalTimeout(180);
    wm.setAPCallback(showWifiSetupScreen);

    if (!wm.autoConnect(AP_NAME, AP_PASSWORD)) {
      Serial.println("WiFi gagal, restart...");
      ESP.restart();
    }
  }

  Serial.println("\nWiFi terhubung!");
  Serial.print("SSID: ");
  Serial.println(WiFi.SSID());
  Serial.print("IP  : ");
  Serial.println(WiFi.localIP());
}

unsigned long lastRead = 0;
const unsigned long READ_INTERVAL = 1000;  // baca + update OLED tiap 1 detik

void loop() {
  handleSerialCommand();
  checkResetButton();          // ← dicek terus, cepat

  // Baca sensor tiap detik (baca terus-menerus), kirim ke API tetap berkala (sendInterval)
  if (millis() - lastRead >= READ_INTERVAL) {
    lastRead = millis();

    // ponytail: requestTemperatures() blocking ~750ms. Kalau perlu baca lebih rapat,
    // pakai sensors.setWaitForConversion(false) + baca hasil di iterasi berikutnya.
    sensors.requestTemperatures();
    float tempC = sensors.getTempCByIndex(0);
    unsigned long uptime = millis() / 1000;

    if (tempC == DEVICE_DISCONNECTED_C) {
      Serial.println("Sensor DS18B20 tidak terbaca");
      display.clearDisplay();
      display.setCursor(0, 0);
      display.println("Sensor error");
      display.display();
    } else {
      // Kirim ke API berkala, terpisah dari irama baca sensor
      if (millis() - lastSend >= sendInterval) {
        lastSend = millis();
        lastHttpCode = sendData(tempC, uptime);
        hasSentOnce = true;
      }

      showMainScreen(tempC, uptime);

      Serial.printf("Temp: %.2f %s | Uptime: %lu s | HTTP: %d\n",
                    tempC, unit, uptime, lastHttpCode);
    }
  }
}